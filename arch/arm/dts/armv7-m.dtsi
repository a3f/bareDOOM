/* SPDX-License-Identifier: GPL-2.0-or-later OR MIT */

/ {
	reboot {
		compatible = "syscon-reboot";
		regmap = <&nvic_scb>;
		offset = <0x0c>;
		mask = <0x05FA0004>;
	};

	nvic_scb: syscon@e000e100  {
		compatible = "syscon";
		reg = <0xe000ed00 0x90>;
	};
};
