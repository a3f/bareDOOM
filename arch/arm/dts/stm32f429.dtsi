/* SPDX-License-Identifier: GPL-2.0-or-later OR MIT */

#include "armv7-m.dtsi"

/ {
	aliases {
		mmc0 = &sdio;
	};

	soc {
		flash: flash@8000000 {
			compatible = "mtd-rom";
			reg = <0x8000000 0x200000>;
		};
	};
};
