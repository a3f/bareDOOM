/* SPDX-License-Identifier: GPL-2.0-or-later OR MIT */

#include <arm/stm32f429-disco.dts>
#include "stm32f429.dtsi"

&systick {
	clock-frequency = <22500000>;
	status = "okay";
};

&spi5 {
	status = "okay";
	pinctrl-0 = <&spi5_pins>;
	pinctrl-names = "default";
	#address-cells = <1>;
	#size-cells = <0>;
	cs-gpios = <&gpioc 1 GPIO_ACTIVE_LOW>, <&gpioc 2 GPIO_ACTIVE_LOW>,
		   <&gpioc 3 GPIO_ACTIVE_LOW>;

	mmc@0 {
		compatible = "mmc-spi-slot";
		reg = <0>;
		spi-max-frequency = <10000000>;
		disable-wp;
	};
};
