## arch/arm/configs/stm32_defconfig
```kconfig
CONFIG_TEXT_BASE=0x20000000
CONFIG_ARCH_STM32MP=y
CONFIG_BOARD_STM32F429I_DISC1=y
CONFIG_THUMB2_BAREBOX=y
# CONFIG_ARM_EXCEPTIONS is not set
CONFIG_ARM_UNWIND=y
CONFIG_IMAGE_COMPRESSION_NONE=y
CONFIG_MEMORY_LAYOUT_FIXED=y
CONFIG_STACK_BASE=0x2002c000
CONFIG_STACK_SIZE=0x4000
CONFIG_MALLOC_BASE=0x10000000
CONFIG_MALLOC_SIZE=0x10000
CONFIG_MALLOC_TLSF=y
CONFIG_KALLSYMS=y
CONFIG_CMDLINE_EDITING=y
CONFIG_AUTO_COMPLETE=y
# CONFIG_TIMESTAMP is not set
CONFIG_BLSPEC=y
CONFIG_FLEXIBLE_BOOTARGS=y
CONFIG_POLLER=y
CONFIG_RESET_SOURCE=y
CONFIG_DEBUG_LL=y
CONFIG_DEBUG_INITCALLS=y
# CONFIG_CMD_DRVINFO is not set
CONFIG_LONGHELP=y
CONFIG_CMD_IOMEM=y
CONFIG_CMD_MEMINFO=y
CONFIG_CMD_POLLER=y
# CONFIG_CMD_BOOTM is not set
# CONFIG_CMD_BOOTU is not set
# CONFIG_CMD_MOUNT is not set
# CONFIG_CMD_UMOUNT is not set
# CONFIG_CMD_CAT is not set
# CONFIG_CMD_CD is not set
# CONFIG_CMD_CP is not set
# CONFIG_CMD_LS is not set
# CONFIG_CMD_MKDIR is not set
# CONFIG_CMD_PWD is not set
# CONFIG_CMD_RM is not set
# CONFIG_CMD_RMDIR is not set
# CONFIG_CMD_FALSE is not set
CONFIG_CMD_MSLEEP=y
CONFIG_CMD_SLEEP=y
# CONFIG_CMD_TEST is not set
# CONFIG_CMD_TRUE is not set
CONFIG_CMD_ECHO_E=y
CONFIG_CMD_MEMTEST=y
CONFIG_CMD_MM=y
CONFIG_CMD_CLK=y
CONFIG_CMD_TIME=y
CONFIG_OFDEVICE=y
CONFIG_OF_BAREBOX_DRIVERS=y
CONFIG_DRIVER_SERIAL_STM32=y
# CONFIG_SPI is not set
CONFIG_CLOCKSOURCE_DUMMY_RATE=15000
```

## arch/arm/mach-v7m/Kconfig
```kconfig
# SPDX-License-Identifier: GPL-2.0-only

if ARCH_V7M

config ARCH_STM32MCU
	bool
	select ARCH_STM32

config MACH_STM32F429_DISCO
	bool "STM32F429 Discovery Development Board"
	select ARCH_STM32MCU


endif
```
